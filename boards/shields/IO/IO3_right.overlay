#include <dt-bindings/zmk/matrix_transform.h>

/ {
    chosen {
        zmk,kscan = &kscan0;
        zmk,matrix_transform = &default_transform;
    };

    kscan0: kscan {
        compatible = "zmk,kscan-gpio-matrix";
        diode-direction = "col2row";
        wakeup-source;

        row-gpios = <&gpio0 6 (GPIO_ACTIVE_HIGH | GPIO_PULL_DOWN)>,
                    <&gpio0 17 (GPIO_ACTIVE_HIGH | GPIO_PULL_DOWN)>,
                    <&gpio0 8 (GPIO_ACTIVE_HIGH | GPIO_PULL_DOWN)>;

    };

&default_transform {
    col-offset = <7>;
};

&kscan0 {
    col-gpios
         =<&pro_micro 9 GPIO_ACTIVE_HIGH>,
          <&pro_micro 8 GPIO_ACTIVE_HIGH>,
          <&pro_micro 7 GPIO_ACTIVE_HIGH>,
          <&pro_micro 6 GPIO_ACTIVE_HIGH>, 
          <&pro_micro 5 GPIO_ACTIVE_HIGH>, 
          <&pro_micro 4 GPIO_ACTIVE_HIGH>, 
          <&pro_micro 3 GPIO_ACTIVE_HIGH>;
};
