## boards/shields/IO/Kconfig.defconfig
```kconfig
if SHIELD_IO_DONGLE
config ZMK_KEYBOARD_NAME
	default "IO3 Dongle"
config ZMK_SPLIT_BLE_ROLE_CENTRAL
	default y
config ZMK_USB
	default y
endif

if SHIELD_IO_LEFT || SHIELD_IO_RIGHT || SHIELD_IO_DONGLE
config ZMK_SPLIT
	default y
config ZMK_BLE
	default y
endif
```

## boards/shields/IO/Kconfig.shield
```kconfig
config SHIELD_IO_LEFT
	def_bool $(shields_list_contains,IO3_left)
config SHIELD_IO_RIGHT
	def_bool $(shields_list_contains,IO3_right)
config SHIELD_IO_DONGLE
	def_bool $(shields_list_contains,IO3_dongle)
```
